## blinky_button_isr_timer_log_i2c_custom/boards/board.yml
```yaml
board:
  name: nrf52840_custom_board_v4
  full_name: nRF52840_custom_board_v4
  vendor: nordic
  socs:
  - name: nrf52840
```

## blinky_button_isr_timer_log_i2c_uart_custom/boards/Kconfig.nrf52840_custom_board_v5
```kconfig
# Copyright (c) 2022 Zephyr Project members and individual contributors
# SPDX-License-Identifier: Apache-2.0

config BOARD_NRF52840_CUSTOM_BOARD_V5
	select SOC_NRF52840_QIAA
```

## blinky_button_isr_timer_log_i2c_uart_custom/boards/board.yml
```yaml
board:
  name: nrf52840_custom_board_v5
  full_name: nRF52840_custom_board_v5
  vendor: nordic
  socs:
  - name: nrf52840
```

## blinky_button_isr_timer_log_i2c_uart_spi/boards/board.yml
```yaml
board:
  name: nrf52840_custom_board_v6
  full_name: nRF52840_custom_board_v6
  vendor: nordic
  socs:
  - name: nrf52840
```

## blinky_button_isr_timer_log_i2c_uart_spi/boards/nrf52840_custom_board_v6_defconfig
```kconfig
# SPDX-License-Identifier: Apache-2.0

# Enable MPU
CONFIG_ARM_MPU=y

# Enable hardware stack protection
CONFIG_HW_STACK_PROTECTION=y

# Enable RTT
CONFIG_USE_SEGGER_RTT=y

# enable GPIO
CONFIG_GPIO=y

# enable uart driver
CONFIG_SERIAL=y

# enable console
CONFIG_CONSOLE=y
CONFIG_UART_CONSOLE=y

#enable i2c driver
CONFIG_I2C=y

# enable async uart driver
CONFIG_UART_ASYNC_API=y

# enable SPI
CONFIG_SPI=y
```
